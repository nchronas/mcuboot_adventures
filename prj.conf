## CMakeLists.txt
```
# SPDX-License-Identifier: Apache-2.0

cmake_minimum_required(VERSION 3.20.0)

# With MCUBOOT
set(CONF_FILE prj.conf shell.conf lfs.conf mcuboot-app.conf)

# Without MCUBOOT
# set(CONF_FILE prj.conf shell.conf lfs.conf)

find_package(Zephyr REQUIRED HINTS $ENV{ZEPHYR_BASE})
project(hello_world)

target_sources(app PRIVATE src/main.c)
# With MCUBOOT
target_sources(app PRIVATE src/mcuboot_shell.c)
target_sources(app PRIVATE src/lfs_shell.c)
target_sources(app PRIVATE src/gpio_shell.c)
```

## sysbuild.conf
```
# Sysbuild configuration file.

# Enable MCUboot per default for this sample.
# SB_CONFIG_BOOTLOADER_MCUBOOT=y
```

## prj.conf
```kconfig
CONFIG_LOG=y
CONFIG_LOG_MODE_MINIMAL=y

CONFIG_PRINTK=y
CONFIG_STDOUT_CONSOLE=y

CONFIG_INIT_STACKS=y
CONFIG_THREAD_STACK_INFO=y
CONFIG_THREAD_MONITOR=y
CONFIG_THREAD_NAME=y
CONFIG_POSIX_CLOCK=y

CONFIG_STATS=y
CONFIG_THREAD_RUNTIME_STATS=y
CONFIG_THREAD_RUNTIME_STATS_USE_TIMING_FUNCTIONS=y

CONFIG_PM_DEVICE=n

CONFIG_DEBUG=y

CONFIG_COMMON_LIBC_MALLOC_ARENA_SIZE=8192

CONFIG_NOCACHE_MEMORY=y

# Enable GPIO
CONFIG_GPIO=ys
CONFIG_PINCTRL=y

CONFIG_NO_OPTIMIZATIONS=y
```

## lfs.conf
```kconfig
CONFIG_DISK_ACCESS=y
CONFIG_DISK_DRIVERS=y
# CONFIG_DISK_DRIVER_SDMMC=y
CONFIG_DISK_DRIVER_MMC=y
CONFIG_MMC_STACK=y
CONFIG_MMC_SUBSYS=y

# CONFIG_MMC_STM32=y
# CONFIG_MMC_STM32_HWFC=y
# CONFIG_MMC_STM32_CLOCK_CHECK=n

CONFIG_MMC_VOLUME_NAME="UNTITLED"


# CONFIG_SDMMC_STM32=y
# CONFIG_SDMMC_STM32_HWFC=y
# CONFIG_SDMMC_STM32_CLOCK_CHECK=n

# CONFIG_SDMMC_VOLUME_NAME="UNTITLED"

CONFIG_FILE_SYSTEM=y
CONFIG_FILE_SYSTEM_LITTLEFS=y

CONFIG_FS_LITTLEFS_BLK_DEV=y

CONFIG_LOG_DEFAULT_LEVEL=3

# Littlefs configuration to utilize QSPI operation
CONFIG_FS_LITTLEFS_CACHE_SIZE=256
CONFIG_FS_LITTLEFS_PROG_SIZE=32
CONFIG_FS_LITTLEFS_READ_SIZE=32
CONFIG_FS_LITTLEFS_LOOKAHEAD_SIZE=64
CONFIG_FS_LITTLEFS_FC_HEAP_SIZE=8192


CONFIG_SHELL_STACK_SIZE=8192
```

## mcuboot-app.conf
```kconfig
# nothing here
CONFIG_BOOT_BANNER=y

# CONFIG_BOOTLOADER_MCUBOOT=y
# # Use the default MCUBoot PEM key file (BOOT_SIGNATURE_KEY_FILE)
CONFIG_MCUBOOT_SIGNATURE_KEY_FILE="bootloader/mcuboot/root-rsa-2048.pem"

CONFIG_REBOOT=y

# Haven't tried it yet
# CONFIG_MCUBOOT_GENERATE_UNSIGNED_IMAGE=y

CONFIG_IMG_MANAGER=y
CONFIG_IMG_ENABLE_IMAGE_CHECK=y
CONFIG_MCUBOOT_IMG_MANAGER=y
CONFIG_IMG_BLOCK_BUF_SIZE=512

CONFIG_FLASH=y
CONFIG_FLASH_MAP=y
CONFIG_FLASH_PAGE_LAYOUT=y
CONFIG_STREAM_FLASH=y
```

## shell.conf
```kconfig
CONFIG_SHELL=y

CONFIG_SHELL_BACKENDS=y
CONFIG_SHELL_BACKEND_SERIAL=y

CONFIG_SHELL_CMDS=y
CONFIG_SHELL_ECHO_STATUS=y

CONFIG_STATS_SHELL=y
CONFIG_DATE_SHELL=y
CONFIG_FILE_SYSTEM_SHELL=y
CONFIG_GPIO_SHELL=y
CONFIG_MCUBOOT_SHELL=y
CONFIG_DEVICE_SHELL=y
CONFIG_KERNEL_SHELL=y
```

## app.overlay
```dts
#include "sysbuild/flash.overlay"
#include "sysbuild/lfs_sd.overlay"

/ {
	chosen {
		zephyr,shell-uart = &usart3;
	};
};

// With MCUBOOT
// / {
//         chosen {
//                 zephyr,code-partition = &slot0_partition;
//         };
// };

// Without MCUBOOT
// / {
//         chosen {
//                 zephyr,code-partition = &boot_partition;
//         };
// };
```

## src/main.c
```c
/*
 * Copyright (c) 2012-2014 Wind River Systems, Inc.
 *
 * SPDX-License-Identifier: Apache-2.0
 */

#include <stdio.h>
#include <zephyr/kernel.h>
#include <stdlib.h>

#include <version.h>
#include <zephyr/drivers/uart.h>
#include "app_version.h"

#include <zephyr/linker/linker-defs.h>

#include <zephyr/drivers/gpio.h>

const struct gpio_dt_spec led0 = GPIO_DT_SPEC_GET(DT_ALIAS(led0), gpios);

int main(void)
{

    printk("Address of sample %p\n", (void *)__rom_region_start);
    printk("Hello sysbuild with mcuboot! %s\n", CONFIG_BOARD);

    k_busy_wait(10000000);
    k_busy_wait(10000);

    const struct device *dev;
    uint32_t dtr = 0;

    gpio_pin_configure_dt(&led0, GPIO_OUTPUT_ACTIVE);

    dev = DEVICE_DT_GET(DT_CHOSEN(zephyr_shell_uart));
    if (!device_is_ready(dev)) {
        return 0;
    }

    while (!dtr) {
        gpio_pin_toggle_dt(&led0);
        k_sleep(K_MSEC(1000));
    }

    return 0;
}
```

## src/gpio_shell.c
```c
#include <stdio.h>
#include <zephyr/kernel.h>

#include <stdlib.h>

#include <zephyr/shell/shell.h>

#include <zephyr/drivers/gpio.h>

const struct gpio_dt_spec led1 = GPIO_DT_SPEC_GET(DT_ALIAS(led1), gpios);

#define CONFIG_COMMS 1

#ifdef CONFIG_COMMS

const struct gpio_dt_spec emmc_en = GPIO_DT_SPEC_GET(DT_NODELABEL(emmc_en), gpios);
const struct gpio_dt_spec emmc_sel = GPIO_DT_SPEC_GET(DT_NODELABEL(emmc_sel), gpios);
const struct gpio_dt_spec emmc_rst = GPIO_DT_SPEC_GET(DT_NODELABEL(emmc_rst), gpios);


// #include "stm32h7xx_hal.h"
#include <soc.h>

#define RF_SPI_SCL_Pin GPIO_PIN_2
#define RF_SPI_SCL_GPIO_Port GPIOE
#define MIXER_RST_Pin GPIO_PIN_3
#define MIXER_RST_GPIO_Port GPIOE
#define RF_SPI_SEL_Pin GPIO_PIN_4
#define RF_SPI_SEL_GPIO_Port GPIOE
#define RF_SPI_MISO_Pin GPIO_PIN_5
#define RF_SPI_MISO_GPIO_Port GPIOE
#define RF_SPI_MOSI_Pin GPIO_PIN_6
#define RF_SPI_MOSI_GPIO_Port GPIOE
#define MMC_RST_Pin GPIO_PIN_13
#define MMC_RST_GPIO_Port GPIOC
#define TCXO_OUT_Pin GPIO_PIN_0
#define TCXO_OUT_GPIO_Port GPIOH
#define TCXO_EN_Pin GPIO_PIN_1
#define TCXO_EN_GPIO_Port GPIOH
#define EN_MIXER_Pin GPIO_PIN_0
#define EN_MIXER_GPIO_Port GPIOC
#define RF_IRQ_Pin GPIO_PIN_1
#define RF_IRQ_GPIO_Port GPIOC
#define RF_IRQ_EXTI_IRQn EXTI1_IRQn
#define EN_AMP_RX_UHF_Pin GPIO_PIN_1
#define EN_AMP_RX_UHF_GPIO_Port GPIOA
#define FLAGB_RX_S_Pin GPIO_PIN_2
#define FLAGB_RX_S_GPIO_Port GPIOA
#define VSET_AGC_S_Pin GPIO_PIN_4
#define VSET_AGC_S_GPIO_Port GPIOA
#define VSET_AGC_UHF_Pin GPIO_PIN_5
#define VSET_AGC_UHF_GPIO_Port GPIOA
#define AGC_TEMP_S_Pin GPIO_PIN_6
#define AGC_TEMP_S_GPIO_Port GPIOA
#define GAIN_SET_S_Pin GPIO_PIN_7
#define GAIN_SET_S_GPIO_Port GPIOA
#define GAIN_SET_UHF_Pin GPIO_PIN_4
#define GAIN_SET_UHF_GPIO_Port GPIOC
#define AGC_TEMP_U_Pin GPIO_PIN_5
#define AGC_TEMP_U_GPIO_Port GPIOC
#define FLT_SEL_UHF_Pin GPIO_PIN_0
#define FLT_SEL_UHF_GPIO_Port GPIOB
#define EN_AGC_UHF_Pin GPIO_PIN_1
#define EN_AGC_UHF_GPIO_Port GPIOB
#define EN_PA_UHF_Pin GPIO_PIN_2
#define EN_PA_UHF_GPIO_Port GPIOB
#define RF_RST_Pin GPIO_PIN_7
#define RF_RST_GPIO_Port GPIOE
#define ALERT_T_PA_U_Pin GPIO_PIN_8
#define ALERT_T_PA_U_GPIO_Port GPIOE
#define FLAGB_TX_UHF_Pin GPIO_PIN_9
#define FLAGB_TX_UHF_GPIO_Port GPIOE
#define FLAGB_RX_UHF_Pin GPIO_PIN_10
#define FLAGB_RX_UHF_GPIO_Port GPIOE
#define EN_RX_UHF_Pin GPIO_PIN_11
#define EN_RX_UHF_GPIO_Port GPIOE
#define ALERT_T_PCB_Pin GPIO_PIN_12
#define ALERT_T_PCB_GPIO_Port GPIOE
#define P5V_RF_EN_Pin GPIO_PIN_13
#define P5V_RF_EN_GPIO_Port GPIOE
#define LED_PE14_Pin GPIO_PIN_14
#define LED_PE14_GPIO_Port GPIOE
#define LED_PE15_Pin GPIO_PIN_15
#define LED_PE15_GPIO_Port GPIOE
#define BUS_SCL_Pin GPIO_PIN_10
#define BUS_SCL_GPIO_Port GPIOB
#define BUS_SDA_Pin GPIO_PIN_11
#define BUS_SDA_GPIO_Port GPIOB
#define FPGA_SPI_SEL_Pin GPIO_PIN_12
#define FPGA_SPI_SEL_GPIO_Port GPIOB
#define FPGA_SPI_SCL_Pin GPIO_PIN_13
#define FPGA_SPI_SCL_GPIO_Port GPIOB
#define FPGA_SPI_MISO_Pin GPIO_PIN_14
#define FPGA_SPI_MISO_GPIO_Port GPIOB
#define FPGA_SPI_MOSI_Pin GPIO_PIN_15
#define FPGA_SPI_MOSI_GPIO_Port GPIOB
#define P5V_FPGA_EN_Pin GPIO_PIN_8
#define P5V_FPGA_EN_GPIO_Port GPIOD
#define P5V_FPGA_PG_Pin GPIO_PIN_9
#define P5V_FPGA_PG_GPIO_Port GPIOD
#define ANT_DET_1_Pin GPIO_PIN_10
#define ANT_DET_1_GPIO_Port GPIOD
#define ANT_DEP_1_Pin GPIO_PIN_11
#define ANT_DEP_1_GPIO_Port GPIOD
#define ANT_DET_0_Pin GPIO_PIN_12
#define ANT_DET_0_GPIO_Port GPIOD
#define ANT_DEP_0_Pin GPIO_PIN_13
#define ANT_DEP_0_GPIO_Port GPIOD
#define ALERT_T_PA_S_Pin GPIO_PIN_14
#define ALERT_T_PA_S_GPIO_Port GPIOD
#define FLAGB_TX_S_Pin GPIO_PIN_15
#define FLAGB_TX_S_GPIO_Port GPIOD
#define MMC_EN_Pin GPIO_PIN_6
#define MMC_EN_GPIO_Port GPIOC
#define P5V_RF_PG_Pin GPIO_PIN_7
#define P5V_RF_PG_GPIO_Port GPIOC
#define MCU_MMC_D0_Pin GPIO_PIN_8
#define MCU_MMC_D0_GPIO_Port GPIOC
#define MIXER_SDA_Pin GPIO_PIN_9
#define MIXER_SDA_GPIO_Port GPIOC
#define MIXER_SCL_Pin GPIO_PIN_8
#define MIXER_SCL_GPIO_Port GPIOA
#define P3V3_RF_PG_Pin GPIO_PIN_9
#define P3V3_RF_PG_GPIO_Port GPIOA
#define MEM_SEL_Pin GPIO_PIN_10
#define MEM_SEL_GPIO_Port GPIOA
#define BUS_SPI_SCL_Pin GPIO_PIN_10
#define BUS_SPI_SCL_GPIO_Port GPIOC
#define BUS_SPI_MISO_Pin GPIO_PIN_11
#define BUS_SPI_MISO_GPIO_Port GPIOC
#define MCU_MMC_CK_Pin GPIO_PIN_12
#define MCU_MMC_CK_GPIO_Port GPIOC
#define CAN1_RX_Pin GPIO_PIN_0
#define CAN1_RX_GPIO_Port GPIOD
#define CAN1_TX_Pin GPIO_PIN_1
#define CAN1_TX_GPIO_Port GPIOD
#define MCU_MMC_CMD_Pin GPIO_PIN_2
#define MCU_MMC_CMD_GPIO_Port GPIOD
#define CAN_EN_Pin GPIO_PIN_3
#define CAN_EN_GPIO_Port GPIOD
#define CAN1_STB_Pin GPIO_PIN_4
#define CAN1_STB_GPIO_Port GPIOD
#define CAN2_EN_Pin GPIO_PIN_5
#define CAN2_EN_GPIO_Port GPIOD
#define BUS_SPI_MOSI_Pin GPIO_PIN_6
#define BUS_SPI_MOSI_GPIO_Port GPIOD
#define CAN2_STB_Pin GPIO_PIN_7
#define CAN2_STB_GPIO_Port GPIOD
#define CAN2_RX_Pin GPIO_PIN_5
#define CAN2_RX_GPIO_Port GPIOB
#define CAN2_TX_Pin GPIO_PIN_6
#define CAN2_TX_GPIO_Port GPIOB
#define SMDATA_Pin GPIO_PIN_7
#define SMDATA_GPIO_Port GPIOB
#define SMCLK_Pin GPIO_PIN_8
#define SMCLK_GPIO_Port GPIOB
#define MIXER_ENX_Pin GPIO_PIN_0
#define MIXER_ENX_GPIO_Port GPIOE
#define FLAGB_MIXER_Pin GPIO_PIN_1
#define FLAGB_MIXER_GPIO_Port GPIOE


static int cmd_tst_mmc(const struct shell *sh, size_t argc, char **argv)
{
    ARG_UNUSED(argc);
    ARG_UNUSED(argv);

    MMC_HandleTypeDef hmmc1;

    GPIO_InitTypeDef GPIO_InitStruct = {0};
  RCC_PeriphCLKInitTypeDef PeriphClkInitStruct = {0};
  if(hmmc1.Instance==SDMMC1)
  {
  /* USER CODE BEGIN SDMMC1_MspInit 0 */

  /* USER CODE END SDMMC1_MspInit 0 */

  /** Initializes the peripherals clock
  */
    PeriphClkInitStruct.PeriphClockSelection = RCC_PERIPHCLK_SDMMC;
    PeriphClkInitStruct.SdmmcClockSelection = RCC_SDMMCCLKSOURCE_PLL;
    if (HAL_RCCEx_PeriphCLKConfig(&PeriphClkInitStruct) != HAL_OK)
    {
        shell_print(sh, "error HAL %u");
    }

    /* Peripheral clock enable */
    __HAL_RCC_SDMMC1_CLK_ENABLE();

    __HAL_RCC_GPIOC_CLK_ENABLE();
    __HAL_RCC_GPIOD_CLK_ENABLE();
    /**SDMMC1 GPIO Configuration
    PC8     ------> SDMMC1_D0
    PC12     ------> SDMMC1_CK
    PD2     ------> SDMMC1_CMD
    */
    GPIO_InitStruct.Pin = MCU_MMC_D0_Pin|MCU_MMC_CK_Pin;
    GPIO_InitStruct.Mode = GPIO_MODE_AF_PP;
    GPIO_InitStruct.Pull = GPIO_PULLUP;
    GPIO_InitStruct.Speed = GPIO_SPEED_FREQ_VERY_HIGH;
    GPIO_InitStruct.Alternate = GPIO_AF12_SDMMC1;
    HAL_GPIO_Init(GPIOC, &GPIO_InitStruct);

    GPIO_InitStruct.Pin = MCU_MMC_CMD_Pin;
    GPIO_InitStruct.Mode = GPIO_MODE_AF_PP;
    GPIO_InitStruct.Pull = GPIO_PULLUP;
    GPIO_InitStruct.Speed = GPIO_SPEED_FREQ_VERY_HIGH;
    GPIO_InitStruct.Alternate = GPIO_AF12_SDMMC1;
    HAL_GPIO_Init(MCU_MMC_CMD_GPIO_Port, &GPIO_InitStruct);
  } 


    // GPIO_InitTypeDef GPIO_InitStruct = {0};

  /* GPIO Ports Clock Enable */
  __HAL_RCC_GPIOE_CLK_ENABLE();
  __HAL_RCC_GPIOC_CLK_ENABLE();
  __HAL_RCC_GPIOH_CLK_ENABLE();
  __HAL_RCC_GPIOA_CLK_ENABLE();
  __HAL_RCC_GPIOB_CLK_ENABLE();
  __HAL_RCC_GPIOD_CLK_ENABLE();

  GPIO_InitStruct.Pin = MCU_MMC_D0_Pin;
  GPIO_InitStruct.Pull = GPIO_PULLUP;
  HAL_GPIO_Init(MCU_MMC_D0_GPIO_Port, &GPIO_InitStruct);

  /*Configure GPIO pin Output Level */
  HAL_GPIO_WritePin(MEM_SEL_GPIO_Port, MEM_SEL_Pin, GPIO_PIN_SET);

  /*Configure GPIO pins : MIXER_RST_Pin MIXER_ENX_Pin */
  GPIO_InitStruct.Pin = MIXER_RST_Pin|MIXER_ENX_Pin;
  GPIO_InitStruct.Mode = GPIO_MODE_OUTPUT_PP;
  GPIO_InitStruct.Pull = GPIO_PULLDOWN;
  GPIO_InitStruct.Speed = GPIO_SPEED_FREQ_LOW;
  HAL_GPIO_Init(GPIOE, &GPIO_InitStruct);

  /*Configure GPIO pins : MMC_RST_Pin EN_MIXER_Pin MMC_EN_Pin */
  GPIO_InitStruct.Pin = MMC_RST_Pin|EN_MIXER_Pin|MMC_EN_Pin;
  GPIO_InitStruct.Mode = GPIO_MODE_OUTPUT_PP;
  GPIO_InitStruct.Pull = GPIO_NOPULL;
  GPIO_InitStruct.Speed = GPIO_SPEED_FREQ_LOW;
  HAL_GPIO_Init(GPIOC, &GPIO_InitStruct);

  /* Initialize EMMC, in v0.2 eMMC is always ON */
  HAL_GPIO_WritePin(MMC_RST_GPIO_Port, MMC_RST_Pin, GPIO_PIN_SET); // 2.184W @ 12V
  HAL_GPIO_WritePin(MMC_EN_GPIO_Port, MMC_EN_Pin, GPIO_PIN_RESET);
//   emmc_memory.set_dir(satnogs::comms::emmc::dir::MCU);
    HAL_GPIO_WritePin(MEM_SEL_GPIO_Port, MEM_SEL_Pin, GPIO_PIN_SET);
  k_sleep(K_MSEC(1000));

	  HAL_MMC_CardInfoTypeDef pCardInfo;
	  HAL_MMC_CardStateTypeDef card_state;
	  HAL_MMC_StateTypeDef state;
      HAL_StatusTypeDef res;


  hmmc1.Instance = SDMMC1;
  hmmc1.Init.ClockEdge = SDMMC_CLOCK_EDGE_RISING;
  hmmc1.Init.ClockPowerSave = SDMMC_CLOCK_POWER_SAVE_DISABLE;
  hmmc1.Init.BusWide = SDMMC_BUS_WIDE_1B;
  hmmc1.Init.HardwareFlowControl = SDMMC_HARDWARE_FLOW_CONTROL_DISABLE;
  hmmc1.Init.ClockDiv = 2;
  res = HAL_MMC_Init(&hmmc1);

    card_state = HAL_MMC_GetCardState(&hmmc1);
    // state = HAL_MMC_GetState(&hmmc1);

  if (res != HAL_OK)
  {
        shell_print(sh, "error HAL 2 %d, %d", res, card_state);
        return 0;

  }


    shell_print(sh, "Initiliazed HAL %d %u %d", res, (res != HAL_OK), card_state);
    
    res = HAL_MMC_GetCardInfo(&hmmc1, &pCardInfo);
    shell_print(sh, "Card info: %u %u %u %u %u %u %u, %d",pCardInfo.CardType, pCardInfo.Class,pCardInfo.RelCardAdd,pCardInfo.BlockNbr,pCardInfo.BlockSize,pCardInfo.LogBlockNbr,pCardInfo.LogBlockSize, res);

//   uint32_t CardType;                     /*!< Specifies the card Type                         */

//   uint32_t Class;                        /*!< Specifies the class of the card class           */

//   uint32_t RelCardAdd;                   /*!< Specifies the Relative Card Address             */

//   uint32_t BlockNbr;                     /*!< Specifies the Card Capacity in blocks           */

//   uint32_t BlockSize;                    /*!< Specifies one block size in bytes               */

//   uint32_t LogBlockNbr;                  /*!< Specifies the Card logical Capacity in blocks   */

//   uint32_t LogBlockSize;                 /*!< Specifies logical block size in bytes           */

    uint8_t wData[512] = {0};
    uint8_t rData[512] = {0};

    strncpy(wData, "Hello LSF\n", 10);
    wData[10] = 0;

    res = HAL_MMC_WriteBlocks(&hmmc1, wData, 1, 1, 1000);
    if (res != HAL_OK)
    {
            shell_print(sh, "error HAL 3 %d", res);
            return 0;
    }

    res = HAL_MMC_ReadBlocks(&hmmc1, rData, 1, 1, 1000);
    if (res != HAL_OK)
    {
            shell_print(sh, "error HAL 4 %d", res);
            return 0;
    }

    rData[10] = 0;

    shell_print(sh, "Read block %s", rData);

/*	for (block = 0; block < pCardInfo.BlockNbr; block++) {
		ret = HAL_MMC_WriteBlocks(&hmmc1, wData, 1, 1, 1000);
		ret = HAL_MMC_ReadBlocks(&hmmc1, rData, 1, 1, 1000);
		if (ret != HAL_OK) break;
	}*/


    return 0;
}

SHELL_CMD_ARG_REGISTER(tst_mmc, NULL, "Initialize GPIO", cmd_tst_mmc, 1, 0);



static int cmd_init_gpio(const struct shell *sh, size_t argc, char **argv)
{
    ARG_UNUSED(argc);
    ARG_UNUSED(argv);

    int res = 0;
    res = gpio_pin_configure_dt(&led1, GPIO_OUTPUT_INACTIVE);

    res |= gpio_pin_configure_dt(&emmc_en, GPIO_OUTPUT_INACTIVE);
    res |= gpio_pin_configure_dt(&emmc_sel, GPIO_OUTPUT_ACTIVE);
    res |= gpio_pin_configure_dt(&emmc_rst, GPIO_OUTPUT_INACTIVE);

    shell_print(sh, "Initiliazed GPIO %u", res);

    return 0;
}

SHELL_CMD_ARG_REGISTER(init_gpio, NULL, "Initialize GPIO", cmd_init_gpio, 1, 0);

static int cmd_set_gpio(const struct shell *sh, size_t argc, char **argv)
{
    if (argc != 3) {
        shell_print(sh, "Not enough arguments");
        return 0;
    }

    char gpio_node = argv[1][0];
    struct gpio_dt_spec *spec;

    if (gpio_node == 'e') {
        spec = &emmc_en;
    } else if (gpio_node == 'd') {
        spec = &emmc_sel;
    } else if (gpio_node == 'l') {
        spec = &led1;    
    } else if (gpio_node == 'r') {
        spec = &emmc_rst;
    } else {
        shell_print(sh, "Wrong argument.");
        return 0;
    }

    char gpio_level = argv[2][0];
    int level = 0;

    if (gpio_level == '0') {
        level = 0;
    } else if (gpio_level == '1') {
        level = 1;
    } else {
        shell_print(sh, "Wrong argument.");
        return 0;
    }

    gpio_pin_set_dt(spec, level);

    shell_print(sh, "Set GPIO");

    return 0;
}

SHELL_CMD_ARG_REGISTER(set_gpio, NULL, "Set GPIO", cmd_set_gpio, 3, 0);

static int cmd_tst_gpio(const struct shell *sh, size_t argc, char **argv)
{



    gpio_pin_set_dt(&emmc_rst, 0);
    k_sleep(K_MSEC(1000));
    gpio_pin_set_dt(&emmc_sel, 1);
    gpio_pin_set_dt(&emmc_en, 0);

    shell_print(sh, "Fingers crossed");

    return 0;
}

SHELL_CMD_ARG_REGISTER(tst, NULL, "Testing mount configuration GPIO", cmd_tst_gpio, 1, 0);

#else

static int cmd_init_gpio(const struct shell *sh, size_t argc, char **argv)
{
    ARG_UNUSED(argc);
    ARG_UNUSED(argv);

    int res = 0;
    res = gpio_pin_configure_dt(&led1, GPIO_OUTPUT_INACTIVE);

    shell_print(sh, "Initiliazed GPIO %u", res);

    return 0;
}

SHELL_CMD_ARG_REGISTER(init_gpio, NULL, "Initialize GPIO", cmd_init_gpio, 1, 0);

static int cmd_set_gpio(const struct shell *sh, size_t argc, char **argv)
{
    if (argc != 3) {
        shell_print(sh, "Not enough arguments");
        return 0;
    }

    char gpio_node = argv[1][0];
    struct gpio_dt_spec *spec;

    if (gpio_node == 'l') {
        spec = &led1;
    } else {
        shell_print(sh, "Wrong argument.");
        return 0;
    }

    char gpio_level = argv[2][0];
    int level = 0;

    if (gpio_level == '0') {
        level = 0;
    } else if (gpio_level == '1') {
        level = 1;
    } else {
        shell_print(sh, "Wrong argument.");
        return 0;
    }

    gpio_pin_set_dt(spec, level);

    shell_print(sh, "Set GPIO");

    return 0;
}

SHELL_CMD_ARG_REGISTER(set_gpio, NULL, "Set GPIO", cmd_set_gpio, 3, 0);

#endif
```

## src/lfs_shell.c
```c
#include <stdio.h>
#include <zephyr/kernel.h>
#include <zephyr/sys/reboot.h>
#include <stdlib.h>

#include <zephyr/shell/shell.h>
#include <version.h>
#include <zephyr/drivers/uart.h>
#include "app_version.h"

#include <zephyr/fs/fs.h>

#include <zephyr/storage/disk_access.h>

#include <zephyr/fs/littlefs.h>


// #include <ff.h>
#include <string.h>

#if defined(CONFIG_DISK_DRIVER_SDMMC)
#define DISK_NAME CONFIG_SDMMC_VOLUME_NAME
#elif IS_ENABLED(CONFIG_DISK_DRIVER_MMC)
#define DISK_NAME CONFIG_MMC_VOLUME_NAME
#else
#error "No disk device defined, is your board supported?"
#endif

#define MAX_PATH_LEN 255

struct fs_littlefs lfsfs;
static struct fs_mount_t __mp = {
    .type = FS_LITTLEFS,
    .fs_data = &lfsfs,
    .flags = FS_MOUNT_FLAG_USE_DISK_ACCESS,
};
struct fs_mount_t *mountpoint = &__mp;

static int cmd_fstatvfs(const struct shell *sh, size_t argc, char **argv)
{
    if (argc != 1) {
        shell_print(sh, "Too many arguments");
        return 0;
    }

    struct fs_statvfs sbuf;
    int rc;

    rc = fs_statvfs(mountpoint->mnt_point, &sbuf);
    if (rc != 0) {
        shell_print(sh, "FAIL: statvfs: %d\n", rc);
        return 0;
    }

    shell_print(sh, "%s: bsize = %lu ; frsize = %lu ;"
            " blocks = %lu ; bfree = %lu\n",
            mountpoint->mnt_point,
            sbuf.f_bsize, sbuf.f_frsize,
            sbuf.f_blocks, sbuf.f_bfree);

    return 0;
}

SHELL_CMD_ARG_REGISTER(vfs_stat, NULL, "Virtual file stats", cmd_fstatvfs, 1, 0);

static int cmd_fstat(const struct shell *sh, size_t argc, char **argv)
{
    if (argc != 2) {
        shell_print(sh, "Not enough arguments");
        return 0;
    }
    char fname[MAX_PATH_LEN];
    snprintf(fname, sizeof(fname), "%s/%s", mountpoint->mnt_point, &argv[1][0]);

    struct fs_dirent sbuf;
    int rc;

    rc = fs_stat(fname, &sbuf);
    shell_print(sh, "File %s stat: %d\n", fname, rc);

    return 0;
}

SHELL_CMD_ARG_REGISTER(fstat, NULL, "SD file stats", cmd_fstat, 2, 0);

static int cmd_frm(const struct shell *sh, size_t argc, char **argv)
{
    if (argc != 2) {
        shell_print(sh, "Not enough arguments");
        return 0;
    }

    int rc = 0;

    char fname[MAX_PATH_LEN];
    snprintf(fname, sizeof(fname), "%s/%s", mountpoint->mnt_point, &argv[1][0]);

    rc = fs_unlink(fname);
    if (rc < 0) {
        shell_print(sh, "FAIL: open %s: %d\n", fname, rc);
    }

    return 0;
}

SHELL_CMD_ARG_REGISTER(rm, NULL, "Removes a file or a directory", cmd_frm, 2, 0);

static int cmd_append(const struct shell *sh, size_t argc, char **argv)
{
    if (argc != 3) {
        shell_print(sh, "Not enough arguments");
        return 0;
    }

    struct fs_file_t file;
    int rc, ret = 0;

    char fname[MAX_PATH_LEN];
    snprintf(fname, sizeof(fname), "%s/%s", mountpoint->mnt_point, &argv[1][0]);

    char txt[10];
    snprintf(txt, sizeof(txt), "%s", &argv[2][0]);

    fs_file_t_init(&file);
    rc = fs_open(&file, fname, FS_O_CREATE | FS_O_WRITE);
    if (rc < 0) {
        shell_print(sh, "FAIL: open %s: %d\n", fname, rc);
        return 0;
    }

    rc = fs_seek(&file, 0, FS_SEEK_END);
    if (rc < 0) {
        shell_print(sh, "FAIL: seek %s: %d\n", fname, rc);
    }

    rc = fs_write(&file, &txt, strnlen(txt, 10));
    if (rc < 0) {
        shell_print(sh, "FAIL: write %s: %d\n", fname, rc);
    }

    ret = fs_close(&file);
    if (ret < 0) {
       shell_print(sh, "FAIL: close %s: %d\n", fname, ret);
        return ret;
    }

    return 0;
}

SHELL_CMD_ARG_REGISTER(append, NULL, "Appends up to 10 chars in a file in the beginning of the file", cmd_append, 3, 0);

static int cmd_fwr(const struct shell *sh, size_t argc, char **argv)
{
    if (argc != 3) {
        shell_print(sh, "Not enough arguments");
        return 0;
    }

    struct fs_file_t file;
    int rc, ret = 0;

    char fname[MAX_PATH_LEN];
    snprintf(fname, sizeof(fname), "%s/%s", mountpoint->mnt_point, &argv[1][0]);

    char txt[10];
    snprintf(txt, sizeof(txt), "%s", &argv[2][0]);

    fs_file_t_init(&file);
    rc = fs_open(&file, fname, FS_O_CREATE | FS_O_WRITE);
    if (rc < 0) {
        shell_print(sh, "FAIL: open %s: %d\n", fname, rc);
        return 0;
    }

    rc = fs_write(&file, &txt, strnlen(txt, 10));
    if (rc < 0) {
        shell_print(sh, "FAIL: write %s: %d\n", fname, rc);
    }

    ret = fs_close(&file);
    if (ret < 0) {
       shell_print(sh, "FAIL: close %s: %d\n", fname, ret);
        return ret;
    }

    return 0;
}

SHELL_CMD_ARG_REGISTER(fwrite, NULL, "Writes up to 10 chars in a file in the beginning of the file", cmd_fwr, 3, 0);

static int cmd_boot_count(const struct shell *sh, size_t argc, char **argv)
{
    ARG_UNUSED(argc);
    ARG_UNUSED(argv);

    uint8_t boot_count = 0;
    struct fs_file_t file;
    int rc, ret;

    char fname[MAX_PATH_LEN];
    snprintf(fname, sizeof(fname), "%s/boot_list", mountpoint->mnt_point);

    fs_file_t_init(&file);
    rc = fs_open(&file, fname, FS_O_CREATE | FS_O_RDWR);
    if (rc < 0) {
        shell_print(sh, "FAIL: open %s: %d\n", fname, rc);
        return rc;
    }

    shell_print(sh, "Read boot list:\n");
    while (1) {

        uint32_t version;

        rc = fs_read(&file, &boot_count, sizeof(boot_count));
        if (rc == 0) {
            break;
        } else if (rc != sizeof(boot_count)) {
            shell_print(sh, "FAIL: read boot_count %s: [rd:%d]", fname, rc);
            break;
        }

        rc = fs_read(&file, &version, sizeof(version));
        if (rc != sizeof(version)) {
            shell_print(sh, "FAIL: read version %s: [rd:%d]", fname, rc);
            break;
        }

        shell_print(sh, "Boot count:%d, version: %u.%u", boot_count, (version >> 16) & 0xFF, (version >> 8) & 0xFF);
    }
    shell_print(sh, "\nRead boot list finished\n");

    // Update table with the new entry of this boot
    boot_count += 1;
    rc = fs_write(&file, &boot_count, sizeof(boot_count));
    if (rc < 0) {
        shell_print(sh, "FAIL: write %s: %d\n", fname, rc);
        goto out;
    }

    uint32_t version = APP_VERSION_NUMBER;

    rc = fs_write(&file, &version, sizeof(version));
    if (rc < 0) {
        shell_print(sh, "FAIL: write %s: %d\n", fname, rc);
        goto out;
    }

    shell_print(sh, "%s write new boot count %u, version %u.%u: [wr:%d]\n", fname, boot_count, APP_VERSION_MAJOR, APP_VERSION_MINOR, rc);  // NOLINT

    out:
    ret = fs_close(&file);
    if (ret < 0) {
        shell_print(sh, "FAIL: close %s: %d\n", fname, ret);
        return ret;
    }

    return 0;
}

SHELL_CMD_ARG_REGISTER(boot_count, NULL, "Updates and reads boot count and versions log", cmd_boot_count, 1, 0);

static int cmd_frd(const struct shell *sh, size_t argc, char **argv)
{
    if (argc != 2) {
        shell_print(sh, "Not enough arguments");
        return 0;
    }

    struct fs_file_t file;
    int rc, ret;

    char fname[MAX_PATH_LEN];
    snprintf(fname, sizeof(fname), "%s/%s", mountpoint->mnt_point, &argv[1][0]);

    fs_file_t_init(&file);
    rc = fs_open(&file, fname, FS_O_READ);
    if (rc < 0) {
        shell_print(sh, "FAIL: open %s: %d\n", fname, rc);
        return 0;
    }

    shell_print(sh, "File content %s:\n", fname);
    do {
        uint8_t temp = 0;

        rc = fs_read(&file, &temp, 1);
        if (rc < 0) {
            shell_print(sh, "\nFAIL: read %s: [rd:%d]", fname, rc);
            break;
        }

        if (rc != 1) {
            break;
        }

        shell_fprintf(sh, SHELL_INFO, "%u", temp);
    } while (rc == 1);
    shell_print(sh, "\nFile content finished\n");

    ret = fs_close(&file);
    if (ret < 0) {
       shell_print(sh, "FAIL: close %s: %d\n", fname, ret);
        return ret;
    }

    return 0;
}

SHELL_CMD_ARG_REGISTER(read, NULL, "SD file read", cmd_frd, 2, 0);

static int cmd_cat(const struct shell *sh, size_t argc, char **argv)
{
    if (argc != 2) {
        shell_print(sh, "Not enough arguments");
        return 0;
    }

    struct fs_file_t file;
    int rc, ret;

    char fname[MAX_PATH_LEN];
    snprintf(fname, sizeof(fname), "%s/%s", mountpoint->mnt_point, &argv[1][0]);

    fs_file_t_init(&file);
    rc = fs_open(&file, fname, FS_O_READ);
    if (rc < 0) {
        shell_print(sh, "FAIL: open %s: %d\n", fname, rc);
        return 0;
    }

    shell_print(sh, "File content %s:\n", fname);
    do {
        char temp[2];
        temp[1] = 0;

        rc = fs_read(&file, temp, 1);
        if (rc < 0) {
            shell_print(sh, "\nFAIL: read %s: [rd:%d]", fname, rc);
            break;
        }

        if (rc != 1) {
            break;
        }

        shell_fprintf(sh, SHELL_INFO, "%s", temp);
    } while (rc == 1);
    shell_print(sh, "\nFile content finished\n");

    ret = fs_close(&file);
    if (ret < 0) {
       shell_print(sh, "FAIL: close %s: %d\n", fname, ret);
        return ret;
    }

    return 0;
}

SHELL_CMD_ARG_REGISTER(cat, NULL, "SD file cat", cmd_cat, 2, 0);

static int cmd_ls(const struct shell *sh, size_t argc, char **argv)
{
    ARG_UNUSED(argc);
    ARG_UNUSED(argv);

    int res;
    struct fs_dir_t dirp;
    static struct fs_dirent entry;

    const char *path = mountpoint->mnt_point;

    fs_dir_t_init(&dirp);

    /* Verify fs_opendir() */
    res = fs_opendir(&dirp, path);
    if (res) {
        shell_print(sh, "Error opening dir %s [%d]\n", path, res);
        return res;
    }

    shell_print(sh, "\nListing dir %s ...\n", path);
    for (;;) {
        /* Verify fs_readdir() */
        res = fs_readdir(&dirp, &entry);

        /* entry.name[0] == 0 means end-of-dir */
        if (res || entry.name[0] == 0) {
            if (res < 0) {
                shell_print(sh, "Error reading dir [%d]\n", res);
            }
            break;
        }

        if (entry.type == FS_DIR_ENTRY_DIR) {
            LOG_PRINTK("[DIR ] %s\n", entry.name);
        } else {
            shell_print(sh, "[FILE] %s (size = %zu)\n",
                    entry.name, entry.size);
        }
    }

    /* Verify fs_closedir() */
    fs_closedir(&dirp);

    return 0;
}

SHELL_CMD_ARG_REGISTER(ls, NULL, "SD LS", cmd_ls, 1, 0);

// static int cmd_info(const struct shell *sh, size_t argc, char **argv)
// {
//     ARG_UNUSED(argc);
//     ARG_UNUSED(argv);

//     static const char *disk_pdrv = "SD";
//     uint64_t memory_size_mb;
//     uint32_t block_count;
//     uint32_t block_size;

//     if (disk_access_init(disk_pdrv) != 0) {
//         shell_print(sh, "Storage init ERROR!");
//         return 0;
//     }

//     if (disk_access_ioctl(disk_pdrv,
//         DISK_IOCTL_GET_SECTOR_COUNT, &block_count)) {
//             shell_print(sh, "Unable to get sector count");
//             return 0;
//     }
//     shell_print(sh, "Block count %u", block_count);

//     if (disk_access_ioctl(disk_pdrv,
//         DISK_IOCTL_GET_SECTOR_SIZE, &block_size)) {
//             shell_print(sh, "Unable to get sector size");
//             return 0;
//     }
//     shell_print(sh, "Sector size %u", block_size);

//     memory_size_mb = (uint64_t)block_count * block_size;
//     shell_print(sh, "Memory Size(MB) %u", (uint32_t)(memory_size_mb >> 20));

//     char fname1[MAX_PATH_LEN];
//     char fname2[MAX_PATH_LEN];
//     struct fs_statvfs sbuf;
//     int rc;

//     snprintf(fname1, sizeof(fname1), "%s/boot_count", mountpoint->mnt_point);
//     snprintf(fname2, sizeof(fname2), "%s/pattern.bin", mountpoint->mnt_point);

//     rc = fs_statvfs(mountpoint->mnt_point, &sbuf);
//     if (rc < 0) {
//         shell_print(sh, "FAIL: statvfs: %d\n", rc);
//         return 0;
//     }

//     shell_print(sh, "%s: bsize = %lu ; frsize = %lu ;"
//             " blocks = %lu ; bfree = %lu\n",
//             mountpoint->mnt_point,
//             sbuf.f_bsize, sbuf.f_frsize,
//             sbuf.f_blocks, sbuf.f_bfree);

//     return 0;
// }

// SHELL_CMD_ARG_REGISTER(info, NULL, "sd info", cmd_info, 1, 0);

static int cmd_unmount(const struct shell *sh, size_t argc, char **argv)
{
    ARG_UNUSED(argc);
    ARG_UNUSED(argv);

    int res = fs_unmount(mountpoint);
    LOG_PRINTK("%s unmount: %d\n", mountpoint->mnt_point, res);

    return 0;
}

SHELL_CMD_ARG_REGISTER(unmount, NULL, "Unmount sd", cmd_unmount, 1, 0);


static int cmd_mount(const struct shell *sh, size_t argc, char **argv)
{
    ARG_UNUSED(argc);
    ARG_UNUSED(argv);

    static const char *disk_mount_pt = "/"DISK_NAME":";
    static const char *disk_pdrv = DISK_NAME;

    mountpoint->storage_dev = (void *)disk_pdrv;
    mountpoint->mnt_point = disk_mount_pt;

    int res = fs_mount(mountpoint);
    if (res < 0) {
        shell_print(sh, "LFS mount error\n");
    } else {
        shell_print(sh, "LFS mounted\n");
    }

    return 0;
}

SHELL_CMD_ARG_REGISTER(mount, NULL, "Mount sd", cmd_mount, 1, 0);
```

## src/mcuboot_shell.c
```c
#include <stdio.h>
#include <zephyr/kernel.h>
#include <zephyr/sys/reboot.h>
#include <stdlib.h>

#include <zephyr/shell/shell.h>
#include <version.h>
#include <zephyr/drivers/uart.h>
#include "app_version.h"

#include <zephyr/dfu/flash_img.h>
#include <zephyr/dfu/mcuboot.h>
#include <zephyr/storage/flash_map.h>

#include <zephyr/linker/linker-defs.h>

#include <zephyr/fs/fs.h>
// #include <zephyr/logging/log.h>

#include <zephyr/storage/disk_access.h>

#include <zephyr/fs/littlefs.h>


static int cmd_read_header(const struct shell *sh, size_t argc, char **argv)
{

    if(argc != 2) {
        shell_print(sh, "Not enough arguments");
        return 0;
    }

    struct mcuboot_img_header hd;
    char area_id = argv[1][0];
    uint8_t fa_id;

    if (area_id == '0') {
        fa_id = FIXED_PARTITION_ID(slot0_partition);
    } else if (area_id == '1') {
        fa_id = FIXED_PARTITION_ID(slot1_partition);
    } else {
        shell_print(sh, "Wrong argument.");

        return 0;
    }

    int err = boot_read_bank_header( fa_id, &hd, sizeof(hd));

    shell_print(sh, "Image header err: %d, image version %d.%d", err, hd.h.v1.sem_ver.major, hd.h.v1.sem_ver.minor);

    return 0;
}

SHELL_CMD_ARG_REGISTER(readhd, NULL, "read image header?", cmd_read_header, 2, 0);


static int cmd_confirmed(const struct shell *sh, size_t argc, char **argv)
{
    ARG_UNUSED(argc);
    ARG_UNUSED(argv);

    shell_print(sh, "Is current image confirmed? %s", (boot_is_img_confirmed()? "Yes": " No :("));

    return 0;
}

SHELL_CMD_ARG_REGISTER(confirmed, NULL, "is image confirmed?", cmd_confirmed, 1, 0);


static int cmd_confirm(const struct shell *sh, size_t argc, char **argv)
{
    ARG_UNUSED(argc);
    ARG_UNUSED(argv);

    shell_print(sh, "Confirm current image. err= %d (0 for ok)", boot_write_img_confirmed());

    return 0;
}

SHELL_CMD_ARG_REGISTER(confirm, NULL, "confirm image", cmd_confirm, 1, 0);

static int cmd_upgrade(const struct shell *sh, size_t argc, char **argv)
{
    ARG_UNUSED(argc);
    ARG_UNUSED(argv);

    int err = boot_request_upgrade(BOOT_UPGRADE_TEST);

    shell_print(sh, "upgrade image. err= %d(0 for ok)", err);

    return 0;
}

SHELL_CMD_ARG_REGISTER(upgrade, NULL, "Upgrade image", cmd_upgrade, 1, 0);


int flag = 0;

static int cmd_flag(const struct shell *sh, size_t argc, char **argv)
{
    ARG_UNUSED(argc);
    ARG_UNUSED(argv);

    shell_print(sh, "Flag= %d", flag);

    flag++;

    return 0;
}

SHELL_CMD_ARG_REGISTER(flag, NULL, "Add one", cmd_flag, 1, 0);


static int cmd_reboot(const struct shell *sh, size_t argc, char **argv)
{
    ARG_UNUSED(argc);
    ARG_UNUSED(argv);

    shell_print(sh, "Reboot MCU Now");

    sys_reboot(0);

    return 0;
}

SHELL_CMD_ARG_REGISTER(reboot, NULL, "Reboot application", cmd_reboot, 1, 0);


static int cmd_version(const struct shell *sh, size_t argc, char **argv)
{
    ARG_UNUSED(argc);
    ARG_UNUSED(argv);

    shell_print(sh, "Application version %s", APP_VERSION_STRING);

    return 0;
}

SHELL_CMD_ARG_REGISTER(version, NULL, "Show application version", cmd_version, 1, 0);
```
