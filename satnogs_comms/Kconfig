## satnogs_comms/Kconfig
```kconfig
###############################################################################
#  SatNOGS-COMMS MCU software
#
#  Copyright (C) 2022, Libre Space Foundation <http://libre.space>
#
#  This program is free software: you can redistribute it and/or modify
#  it under the terms of the GNU General Public License as published by
#  the Free Software Foundation, either version 3 of the License, or
#  (at your option) any later version.
#
#  This program is distributed in the hope that it will be useful,
#  but WITHOUT ANY WARRANTY; without even the implied warranty of
#  MERCHANTABILITY or FITNESS FOR A PARTICULAR PURPOSE.  See the
#  GNU General Public License for more details.
#
#  You should have received a copy of the GNU General Public License
#  along with this program.  If not, see <http://www.gnu.org/licenses/>.
#
#  SPDX-License-Identifier: GNU General Public License v3.0 or later
###############################################################################

if BOARD_SATNOGS_COMMS

config CAN1_ISOTP_TX_ADDR
    hex "ISOTP identifier for the CAN1 TX interface"
    default 0x1
    help
       This is the address that will be used for ISOTP frames
       that are transmitted from the CAN1 interface

config CAN1_ISOTP_RX_ADDR
    hex "ISOTP identifier for the CAN1 RX interface"
    default 0x2
    help
       This is the address that will be used for ISOTP FC frames
       that are transmitted from the CAN1 interface when ISOTP frames
       are received

config CAN1_ISOTP_REMOTE_PEER_TX_ADDR
    hex "ISOTP remote identifier used for TX frames for the CAN1"
    default 0x11

config CAN1_ISOTP_REMOTE_PEER_RX_ADDR
    hex "ISOTP identifier for the CAN1 RX interface"
    default 0x12

config MAX_MTU
    int "Maximum MTU size of all communication interfaces (CAN-ISOTP, RF, SPI)"
    default 1024

config RX_MSGQ_SIZE
    int "The number of messages the RX message queue can hold"
    default 4
    help
       All communication interfaces submit their messages to this queue.
       Consider your workload when assigning a value.

config CAN1_TX_MSGQ_SIZE
    int "The number of messages the CAN1 message queue can hold"
    default 2

config MSG_ARBITER_STACK_SIZE
    int "Stack size of the message arbiter thread"
    default 2048
    help
      This thread handles quite complex routines with deep call stack.
      Consider a high stack size value

config MSG_ARBITER_PRIO
    int "Priority of the message arbiter thread"
    default 5

config CAN1_THREAD_STACK_SIZE
    int "Stack size of the CAN1 thread"
    default 512

config CAN1_THREAD_PRIO
    int "Priority of the CAN1 thread"
    default 4

config MAIN_WORKQUEUE_STACK_SIZE
    int "Stack size of the main workqueue thread"
    default 256

config MAIN_WORKQUEUE_PRIO
    int "Priority of the main workqueue thread"
    default 5

config ASYNC_WORKQUEUE_STACK_SIZE
    int "Stack size of the workqueue thread used for async work items submission"
    default 1024

config ASYNC_WORKQUEUE_PRIO
    int "Priority of the main workqueue thread used for async work items submission"
    default 6

config TELEMETRY_THREAD_STACK_SIZE
    int "Stack size of the telemetry thread"
    default 1024

config TELEMETRY_THREAD_PRIO
    int "Priority of of the telemetry thread"
    default 3

config ENABLE_I2C_REVOVERY
    bool "Enable the I2C bus recovery mechanism"
    default y

config I2C_RECOVERY_RETRIES
    int "How many times to execute the bus recovery mechanism, until an error is raised"
    default 3
    range 1 1024

config ENABLE_DEBUG_UTILS
    bool "Enable extra debug utilities (e.g SeggerRTT)"
    default n

endif
```

## satnogs_comms/satnogs_comms_defconfig
```kconfig
###############################################################################
#  SatNOGS-COMMS MCU software
#
#  Copyright (C) 2022-2024, Libre Space Foundation <http://libre.space>
#
#  This program is free software: you can redistribute it and/or modify
#  it under the terms of the GNU General Public License as published by
#  the Free Software Foundation, either version 3 of the License, or
#  (at your option) any later version.
#
#  This program is distributed in the hope that it will be useful,
#  but WITHOUT ANY WARRANTY; without even the implied warranty of
#  MERCHANTABILITY or FITNESS FOR A PARTICULAR PURPOSE.  See the
#  GNU General Public License for more details.
#
#  You should have received a copy of the GNU General Public License
#  along with this program.  If not, see <http://www.gnu.org/licenses/>.
#
#  SPDX-License-Identifier: GNU General Public License v3.0 or later
###############################################################################

CONFIG_SOC_SERIES_STM32H7X=y
CONFIG_SOC_STM32H723XX=y

# Enable MPU and FPU
CONFIG_ARM_MPU=y
CONFIG_FPU=y

# Enable stack protection
# CONFIG_ENTROPY_GENERATOR=y
# CONFIG_HW_STACK_PROTECTION=y
# CONFIG_STACK_SENTINEL=y
# CONFIG_MPU_STACK_GUARD=y
# CONFIG_SYSTEM_WORKQUEUE_STACK_SIZE=1024
# CONFIG_MAIN_STACK_SIZE=1024
# CONFIG_IDLE_STACK_SIZE=512
# CONFIG_STACK_USAGE=y


# Enable UART
CONFIG_SERIAL=y

# Console
CONFIG_CONSOLE=y
CONFIG_UART_CONSOLE=y

# Enable GPIO
CONFIG_GPIO=y

# Enable clocks
CONFIG_CLOCK_CONTROL=y

# Enable pin controller
CONFIG_PINCTRL=y


# C++ please!
# CONFIG_NEWLIB_LIBC=y
# CONFIG_NEWLIB_LIBC_NANO=n
# CONFIG_CPLUSPLUS=y
# CONFIG_STD_CPP17=y
# CONFIG_LIB_CPLUSPLUS=y
# CONFIG_CPP_EXCEPTIONS=y

# Watchdog
# CONFIG_WATCHDOG=y
# CONFIG_IWDG_STM32=y
# CONFIG_IWDG_STM32_INITIAL_TIMEOUT=12000
# CONFIG_WDT_DISABLE_AT_BOOT=y
# CONFIG_TASK_WDT=y

# This should match the maximum number of tasks that need the watchdog
# CONFIG_TASK_WDT_CHANNELS=8
# CONFIG_TASK_WDT_MIN_TIMEOUT=4000
# CONFIG_TASK_WDT_HW_FALLBACK_DELAY=100

# Enable ADC and DAC
# CONFIG_ADC=y
# CONFIG_DAC=y

# CONFIG_SPI=y
# CONFIG_I2C=y
# CONFIG_I2C_STM32_INTERRUPT=y

# .proto everything!
CONFIG_NANOPB=y

# CAN related configuration
# CONFIG_CAN=y
# CONFIG_CAN_STM32=y
# CONFIG_CAN_MAX_FILTER=2
# CONFIG_CAN_AUTO_BUS_OFF_RECOVERY=y
# CONFIG_ISOTP=y
# CONFIG_ISOTP_RX_BUF_SIZE=1024
# CONFIG_ISOTP_RX_SF_FF_BUF_COUNT=2

# Super useful configuration options for debugging
# CONFIG_THREAD_NAME=y
# CONFIG_DEBUG_THREAD_INFO=y
# CONFIG_THREAD_MONITOR=y
# CONFIG_INIT_STACKS=y
# CONFIG_INIT_STACKS=y
# CONFIG_THREAD_STACK_INFO=y
# CONFIG_TRACING=y
# CONFIG_TRACING_OBJECT_TRACKING=y
# CONFIG_MEM_SLAB_TRACE_MAX_UTILIZATION=y
# CONFIG_WAITQ_SCALABLE=y

# eMMC and littlefs related configuration
# CONFIG_DISK_ACCESS=y
# CONFIG_DISK_DRIVERS=y
# CONFIG_DISK_DRIVER_SDMMC=y
# CONFIG_MMC_STACK=y
# CONFIG_SDMMC_STM32_HWFC=y
# CONFIG_FILE_SYSTEM=y
# CONFIG_FILE_SYSTEM_LITTLEFS=y
# CONFIG_FS_LITTLEFS_BLK_DEV=y
# CONFIG_NOCACHE_MEMORY=y


# Segger RTT
# CONFIG_CONSOLE=y
# CONFIG_LOG_BACKEND_RTT=y
# CONFIG_LOG_BACKEND_RTT_MODE_DROP=y
# CONFIG_LOG_PRINTK=y
# CONFIG_USE_SEGGER_RTT=y
# CONFIG_RTT_CONSOLE=y
# CONFIG_UART_CONSOLE=n
```
